## samples/net/zperf/boards/alif_e7_dk_ae722f80f55d5xx_apss.conf
```kconfig
# Debug
# CONFIG_LOG_PRINTK=y
# CONFIG_HW_STACK_PROTECTION=y
# CONFIG_DEBUG_THREAD_INFO=y
# CONFIG_NO_OPTIMIZATIONS=y

# Stack sizes
CONFIG_MAIN_STACK_SIZE=5120
CONFIG_SHELL_STACK_SIZE=5120
CONFIG_NET_TX_STACK_SIZE=5120
CONFIG_NET_RX_STACK_SIZE=5120
CONFIG_NET_MGMT_EVENT_STACK_SIZE=2048
CONFIG_SYSTEM_WORKQUEUE_STACK_SIZE=5120
CONFIG_NET_SOCKETS_SERVICE_STACK_SIZE=2048
CONFIG_NET_TCP_WORKQ_STACK_SIZE=4096

# Init IPV6
CONFIG_NET_CONFIG_AUTO_INIT=y
CONFIG_NET_CONFIG_NEED_IPV6=y

# Network overrides for WiFi offload
CONFIG_NET_IPV6=n
CONFIG_NET_DHCPV4=y
CONFIG_NET_PKT_RX_COUNT=40
CONFIG_NET_PKT_TX_COUNT=40
CONFIG_NET_BUF_RX_COUNT=80
CONFIG_NET_BUF_TX_COUNT=80
CONFIG_NET_BUF_DATA_SIZE=1024
CONFIG_NET_MAX_CONTEXTS=10
CONFIG_NET_MAX_CONN=16
CONFIG_NET_TCP_MAX_RECV_WINDOW_SIZE=32768
CONFIG_NET_TCP_MAX_SEND_WINDOW_SIZE=32768
CONFIG_NET_OFFLOAD=y
CONFIG_ZVFS_POLL_MAX=16

CONFIG_DNS_RESOLVER=y
CONFIG_DNS_RESOLVER_MAX_SERVERS=2
CONFIG_NET_L2_WIFI_SHELL=y
```
